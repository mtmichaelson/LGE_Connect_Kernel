## kernel/Kconfig.sysprof
```kconfig
menu "LG expand option"

config LG_SYSPROF
	bool "LG System Profiler"
	default n
	help
		trace scheduler wakeup latency per tasks.

config LG_SYSPROF_KEVENT
	bool "LG System Profiler : Collect Kernel Event"
	default n
	depends on LG_SYSPROF
	help
		trace kernel event with related to CPU or specific event 
		that is already predefined

endmenu
```

## lge/com_device/mhl_v1/Kconfig
```kconfig
#

config LGE_MHL_SII9244
	depends on ARCH_MSM8X60
	default n
	bool "MHL(sii9244)"
	help
		This is a MHL(sii9244) drvier for Qualcomm MSM8x60 based chipsets.
```
